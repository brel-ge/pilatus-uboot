## board/variscite/imx8mp_var_som_pilatus/Kconfig
```kconfig
if TARGET_IMX8MP_VAR_SOM_PILATUS

config SYS_BOARD
	default "imx8mp_var_som_pilatus"

config SYS_VENDOR
	default "variscite"

config SYS_CONFIG_NAME
	default "imx8mp_var_som_pilatus"

menu "IMX8MP Pilatus specific settings"

config BMP_LOGO_EXT4_EN
	bool "Enable the loading of boot logo from mmc"
	depends on VIDEO

config BMP_LOGO_FILENAME
	string "BMP filename to load boot logo from mmc"
	default "bootlogo.bmp"
	depends on BMP_LOGO_EXT4_EN

config BMP_LOGO_MMC_DEV
	int "MMC device number  to load boot logo from"
	default 2
	depends on BMP_LOGO_EXT4_EN

config BMP_LOGO_MMC_PART
	int "MMC device partition number  to load boot logo from"
	default 3
	depends on BMP_LOGO_EXT4_EN
endmenu

endif
```
